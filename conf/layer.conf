## conf/layer.conf
```bitbake
BBPATH .= ":${LAYERDIR}"

BBFILES += "\
            ${LAYERDIR}/recipes-*/*/*.bb \
            ${LAYERDIR}/recipes-*/*/*.bbappend \
           "

BBFILE_COLLECTIONS += "wpe-tv-layer"
BBFILE_PATTERN_wpe-tv-layer := "^${LAYERDIR}/"
BBFILE_PRIORITY_wpe-tv-layer = "21"

LAYERDEPENDS_wpe-tv-layer = "core \
                          openembedded-layer \
                          multimedia-layer \
                          networking-layer \
                          meta-python \
                         "

LICENSE_PATH += "${LAYERDIR}/licenses"

# WPE TVControl on rpi needs libav plugin
LICENSE_FLAGS_WHITELIST += "commercial_gstreamer1.0-libav"
```
